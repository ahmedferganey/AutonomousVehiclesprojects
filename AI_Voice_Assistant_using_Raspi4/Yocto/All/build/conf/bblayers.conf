## AI_Voice_Assistant_using_Raspi4/Yocto/All/build/conf/bblayers.conf
```bitbake
# POKY_BBLAYERS_CONF_VERSION is increased each time build/conf/bblayers.conf
# changes incompatibly
POKY_BBLAYERS_CONF_VERSION = "2"

BBPATH = "${TOPDIR}"
BBFILES ?= ""

BBLAYERS ?= " \
  /home/ferganey/Projects/Yocto/Yocto_sources/poky/meta \
  /home/ferganey/Projects/Yocto/Yocto_sources/poky/meta-poky \
  /home/ferganey/Projects/Yocto/Yocto_sources/poky/meta-raspberrypi \
  /home/ferganey/Projects/Yocto/Yocto_sources/poky/meta-virtualization \
  /home/ferganey/Projects/Yocto/Yocto_sources/poky/meta-openembedded/meta-oe \
  /home/ferganey/Projects/Yocto/Yocto_sources/poky/meta-openembedded/meta-filesystems \
  /home/ferganey/Projects/Yocto/Yocto_sources/poky/meta-openembedded/meta-python \
  /home/ferganey/Projects/Yocto/Yocto_sources/poky/meta-openembedded/meta-networking \
  /home/ferganey/Projects/Yocto/Yocto_sources/poky/meta-openembedded/meta-multimedia \
  /home/ferganey/Projects/Yocto/Yocto_sources/poky/meta-docker \
  /home/ferganey/Projects/Yocto/Yocto_sources/poky/meta-qt6 \
  /home/ferganey/Projects/Yocto/Yocto_sources/poky/meta-userapp \
  /home/ferganey/Projects/Yocto/Yocto_sources/poky/meta-tensorflow-lite \
  /home/ferganey/Projects/Yocto/Yocto_sources/poky/meta-onnxruntime \
  "
```

## AI_Voice_Assistant_using_Raspi4/Yocto/All/meta-userapp/conf/layer.conf
```bitbake
# We have a conf and classes directory, add to BBPATH
BBPATH .= ":${LAYERDIR}"

# We have recipes-* directories, add to BBFILES
BBFILES += "${LAYERDIR}/recipes-*/*/*.bb \
            ${LAYERDIR}/recipes-*/*/*.bbappend"
            
# Ensure Yocto can locate the custom bbclass files
BBCLASS_PATH .= ":${LAYERDIR}/recipes-core/custom"

BBFILE_COLLECTIONS += "meta-userapp"
BBFILE_PATTERN_meta-userapp = "^${LAYERDIR}/"
BBFILE_PRIORITY_meta-userapp = "6"

LAYERDEPENDS_meta-userapp = "core"
LAYERSERIES_COMPAT_meta-userapp = "kirkstone"
```
